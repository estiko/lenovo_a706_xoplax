## Kconfig.rej
```kconfig
--- Kconfig
+++ Kconfig
@@ -252,6 +252,12 @@
 	help
 	  Use the CPUFreq governor 'virtous' as default.
 
+config CPU_FREQ_DEFAULT_GOV_PEGASUSQ
+	bool "pegasusq"
+	select CPU_FREQ_GOV_PEGASUSQ
+	help
+	  Use the CPUFreq governor 'pegasusq' as default.
+
 endchoice
 
 config CPU_FREQ_GOV_PERFORMANCE
@@ -645,6 +651,9 @@
 	tristate "'savagedzen' cpufreq governor"
 	depends on CPU_FREQ
 
+config CPU_FREQ_GOV_PEGASUSQ
+	tristate "'pegasusq' cpufreq policy governor"
+
 menu "x86 CPU frequency scaling drivers"
 depends on X86
 source "drivers/cpufreq/Kconfig.x86"
```
